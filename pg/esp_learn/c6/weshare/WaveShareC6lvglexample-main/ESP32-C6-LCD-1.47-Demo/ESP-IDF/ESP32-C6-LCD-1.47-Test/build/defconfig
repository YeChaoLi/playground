## pg/esp_learn/c6/weshare/WaveShareC6lvglexample-main/ESP32-C6-LCD-1.47-Demo/ESP-IDF/ESP32-C6-LCD-1.47-Test/build/defconfig
```kconfig
CONFIG_ESPTOOLPY_FLASHSIZE_4MB=y
CONFIG_PARTITION_TABLE_CUSTOM=y
CONFIG_LV_USE_PERF_MONITOR=y
CONFIG_LV_FONT_MONTSERRAT_8=y
CONFIG_LV_FONT_MONTSERRAT_10=y
CONFIG_LV_FONT_MONTSERRAT_18=y
CONFIG_LV_FONT_MONTSERRAT_24=y
CONFIG_LV_FONT_MONTSERRAT_48=y
```

## pg/esp_learn/p4/wifi/file_server/file_serving/sdkconfig.defaults
```kconfig
CONFIG_PARTITION_TABLE_CUSTOM=y
CONFIG_PARTITION_TABLE_CUSTOM_FILENAME="partitions_example.csv"
CONFIG_PARTITION_TABLE_FILENAME="partitions_example.csv"

CONFIG_IDF_TARGET="esp32p4"
CONFIG_ESP_STATION_EXAMPLE_WPA3_SAE_PWE_HUNT_AND_PECK=y
CONFIG_ESP_MAXIMUM_RETRY=50

CONFIG_COMPILER_OPTIMIZATION_SIZE=y

CONFIG_ESP_HOSTED_CUSTOM_SDIO_PINS=y
CONFIG_ESP_HOSTED_PRIV_SDIO_PIN_CMD_SLOT_1=44
CONFIG_ESP_HOSTED_PRIV_SDIO_PIN_CLK_SLOT_1=43
CONFIG_ESP_HOSTED_PRIV_SDIO_PIN_D0_SLOT_1=42
CONFIG_ESP_HOSTED_PRIV_SDIO_PIN_D1_4BIT_BUS_SLOT_1=41
CONFIG_ESP_HOSTED_PRIV_SDIO_PIN_D2_4BIT_BUS_SLOT_1=40
CONFIG_ESP_HOSTED_PRIV_SDIO_PIN_D3_4BIT_BUS_SLOT_1=39
CONFIG_ESP_HOSTED_SDIO_GPIO_RESET_SLAVE=9

CONFIG_TINYUSB_DESC_USE_ESPRESSIF_VID=n
CONFIG_TINYUSB_DESC_CUSTOM_VID=0x16D0
CONFIG_TINYUSB_DESC_USE_DEFAULT_PID=n
CONFIG_TINYUSB_DESC_CUSTOM_PID=0x1336
CONFIG_TINYUSB_DESC_MANUFACTURER_STRING="Formlabs"
CONFIG_TINYUSB_DESC_PRODUCT_STRING="Form Cure 2L"
CONFIG_TINYUSB_DESC_CDC_STRING="Form Cure 2L Logging"
CONFIG_TINYUSB_CDC_ENABLED=y
CONFIG_TINYUSB_CDC_COUNT=2
CONFIG_TINYUSB_CDC_RX_BUFSIZE=4096
CONFIG_TINYUSB_CDC_TX_BUFSIZE=4096
CONFIG_TINYUSB_DFU_MODE_DFU=y
CONFIG_TINYUSB_DFU_BUFSIZE=4096
```
